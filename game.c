#include <stdio.h>
#include <stdint.h>
#include "ST7735.h"
#include "PLLFunction.h"
#include "tm4c123gh6pm.h"
#include "TimerFunctions.h"
#include "PortInitFunctions.h"
#include "SysTickFunction.h"
#include "SoundFunctions.h"
#include "ADCFunctions.h"

//Turn on One ELF Section per Function to remove unused functions
//TODO
//Implement a start over feature

// ********** ST7735 TFT *******************
// ST7735
// Backlight (pin 10) connected to +3.3 V
// MISO (pin 9) unconnected
// SCK (pin 8) connected to PA2 (SSI0Clk)
// MOSI (pin 7) connected to PA5 (SSI0Tx)
// TFT_CS (pin 6) connected to PA3 (SSI0Fss)
// CARD_CS (pin 5) unconnected
// Data/Command (pin 4) connected to PA6 (GPIO), high for data, low for command
// RESET (pin 3) connected to PA7 (GPIO)
// VCC (pin 2) connected to +3.3 V
// Gnd (pin 1) connected to ground

// ********** ADC *******************
// ADC input connected to PE4

// ********** 4-BIT DAC *******************
// DAC output connected to PB0 - PB3

// ********** LEDs *******************
// LEDs are connected to PD0 (red) - PD2 (green)

// ********** Button *******************
//Button is connected to PD3

void SystemInit(void){}

//const to store big amount of unchanging data in the plentiful ROM
const unsigned short PlayerArt[] = {
 0xFFFF, 0xFFFF, 0xFFFF, 0xFFFF, 0xFFFF, 0xFFFF, 0xFFFF, 0xFFFF, 0xFFFF, 0xFFFF, 0xFFFF, 0xFFFF, 0xFFFF, 0xFFFF, 0xFFFF, 0xFFFF,
 0xFFFF, 0xFFFF, 0xFFFF, 0xFFFF, 0xFFFF, 0xFFFF, 0xFFFF, 0xFFFF, 0xFFFF, 0xFFFF, 0xFFFF, 0xFFFF, 0xFFFF, 0xFFFF, 0xFFFF, 0xFFFF,
 0xFFFF, 0xFFFF, 0xFFFF, 0xFFFF, 0xFFFF, 0xFFFF, 0xFFFF, 0xFFFF, 0xFFFF, 0xFFFF, 0xFFFF, 0xFFFF, 0xFFFF, 0xFFFF, 0xFFFF, 0xFFFF,
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 0xFFFF, 0xFFFF, 0xFFFF, 0xFFFF,

};

const unsigned short BasicEnemyArt[] = {
 0xFFFF, 0xFFFF, 0xFFFF, 0xFFFF, 0xFFFF, 0xFFFF, 0xFFFF, 0xFFFF, 0xFFFF, 0xFFFF, 0xFFFF, 0xFFFF, 0xFFFF, 0xFFFF, 0xFFFF, 0xFFFF,
 0xFFFF, 0xFFFF, 0xFFFF, 0xFFFF, 0xFFFF, 0xFFFF, 0xFFFF, 0xFFFF, 0xFFFF, 0xFFFF, 0xFFFF, 0xFFFF, 0xFFFF, 0xFFFF, 0xFFFF, 0xFFFF,
 0xFFFF, 0xFFFF, 0xFFFF, 0xFFFF, 0xFFFF, 0xFFFF, 0xFFFF, 0xFFFF, 0xFFFF, 0xFFFF, 0xFFFF, 0xFFFF, 0xFFFF, 0xFFFF, 0xFFFF, 0xFFFF,
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 0xFFFF, 0xFFFF, 0xFFFF, 0xFFFF,

};


const unsigned short BulletArt[] = {
 0xFFFF, 0x0000, 0xFFFF, 0xFFFF, 0x0000, 0xFFFF, 0xFFFF, 0x0000, 0xFFFF, 0x057F, 0x071F, 0x057F, 0xFFFF, 0x02FF, 0xFFFF, 0xFFFF,
 0xFFFF, 0xFFFF,

};

const unsigned short PlayerBulletArt[] = {
 0xFFFF, 0xFFFF, 0xFFFF,0xFFFF, 0xFFFF, 0xFFFF, 0xFFFF, 0x01DF, 0xFFFF, 0x053F, 0x07BF, 0x053F, 0xFFFF, 0x0000, 0xFFFF, 0xFFFF, 0x0000, 0xFFFF, 0xFFFF,
 0x1013, 0xFFFF,

};

const unsigned short VictoryArt[] = {
 0xFFFF, 0xFFFF, 0xFFFF, 0xFFFF, 0xFFFF, 0xFFFF, 0xFFFF, 0xFFFF, 0xFFFF, 0xFFFF, 0xFFFF, 0xFFFF, 0xFFFF, 0xFFFF, 0xFFFF, 0xFFFF,
 0xFFFF, 0xFFFF, 0xFFFF, 0xFFFF, 0xFFFF, 0xFFFF, 0xFFFF, 0xFFFF, 0xFFFF, 0xFFFF, 0xFFFF, 0xFFFF, 0xFFFF, 0xFFFF, 0xFFFF, 0xFFFF,
 0xFFFF, 0xFFFF, 0xFFFF, 0xFFFF, 0xFFFF, 0xFFFF, 0xFFFF, 0xFFFF, 0xFFFF, 0xFFFF, 0xFFFF, 0xFFFF, 0xFFFF, 0xFFFF, 0xFFFF, 0xFFFF,
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 0xFFFF, 0xFFFF, 0xFFFF, 0xFFFF,

};

const unsigned short ExplosionArt[] = {
 0xFFFF, 0xFFFF, 0xFFFF, 0xFFFF, 0xFFFF, 0xFFFF, 0xFFFF, 0xFFFF, 0xFFFF, 0xFFFF, 0xFFFF, 0xFFFF, 0xFFFF, 0xFFFF, 0xFFFF, 0xFFFF,
 0xFFFF, 0xFFFF, 0xFFFF, 0xFFFF, 0xFFFF, 0xFFFF, 0xFFFF, 0xFFFF, 0xFFFF, 0xFFFF, 0xFFFF, 0xFFFF, 0xFFFF, 0xFFFF, 0xFFFF, 0xFFFF,
 0xFFFF, 0xFFFF, 0xFFFF, 0xFFFF, 0xFFFF, 0xFFFF, 0xFFFF, 0xFFFF, 0xFFFF, 0xFFFF, 0xFFFF, 0xFFFF, 0xFFFF, 0xFFFF, 0xFFFF, 0xFFFF,
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 0xFFFF, 0xFFFF, 0xFFFF, 0xFFFF,

};

const unsigned short DeathArt[] = {
 0xFFFF, 0xFFFF, 0xFFFF, 0xFFFF, 0xFFFF, 0xFFFF, 0xFFFF, 0xFFFF, 0xFFFF, 0xFFFF, 0xFFFF, 0xFFFF, 0xFFFF, 0xFFFF, 0xFFFF, 0xFFFF,
 0xFFFF, 0xFFFF, 0xFFFF, 0xFFFF, 0xFFFF, 0xFFFF, 0xFFFF, 0xFFFF, 0xFFFF, 0xFFFF, 0xFFFF, 0xFFFF, 0xFFFF, 0xFFFF, 0xFFFF, 0xFFFF,
 0xFFFF, 0xFFFF, 0xFFFF, 0xFFFF, 0xFFFF, 0xFFFF, 0xFFFF, 0xFFFF, 0xFFFF, 0xFFFF, 0xFFFF, 0xFFFF, 0xFFFF, 0xFFFF, 0xFFFF, 0xFFFF,
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 0xFFFF, 0xFFFF, 0xFFFF, 0xFFFF,

};


typedef enum {dead,alive} status_t;
struct sprite{
	int32_t x;												//x coordinate
	int32_t y;												//y coordinate
	int32_t vx,vy;										//Velocity of movement (pixels/30Hz)
	const unsigned short *image;			//ptr->image of alive
	uint8_t deathSeq;									//Indicates the # of death animations
	status_t life;										//Indicates whether status of entity is dead or alive
	uint8_t lifenum;									//Gives # of lives to entity
	uint32_t w;												//width
	uint32_t h;												//height
	uint32_t needDraw;								//Semaphore game engine set if sprite needs to be drawn
	uint32_t leftHitbox;							//left hitbox marker for entity
	uint32_t rightHitbox;							//right hitbox marker for entity
	uint32_t frontHitbox;							//front hitbox marker for entity
	uint32_t backHitbox;							//back hitbox marker for entity
	
};
	
typedef struct sprite sprite_t;	//Initalize an array of basic enemies with properties in sprite struct
sprite_t Enemy[2];
sprite_t Bullet[8];
sprite_t Player[1];
sprite_t PBullet[3];

int Flag;					//Semaphore to ensure game movement runs before game draw
int victoryOver;	//Semaphore to signal the game is over and the player has won
int gameOver;			//Semaphore to signal the game is over and the player has lost

////////////////////////////////////////////////////////////////////
//Initialize the starting condition of the enemies upon game start//
////////////////////////////////////////////////////////////////////
void GameInit(void){
	
	int i;
	Flag = 0;	//Sets flag to 0 so GameDraw will not execute before GameMovement after initialization
	
		//Initialization for player
		Player[0].x = 60;
		Player[0].y = 160;
		Player[0].vx = 0;
		Player[0].vy = 0;
		Player[0].image = PlayerArt;
		Player[0].life = alive;
		Player[0].lifenum = 3;
		Player[0].deathSeq = 0;
		Player[0].w = 30;
		Player[0].h = 30;
		Player[0].needDraw = 1;
		Player[0].leftHitbox = Player[0].x;
		Player[0].rightHitbox = Player[0].x + Player[0].w;
		Player[0].frontHitbox = Player[0].y - Player[0].h;
		Player[0].backHitbox = Player[0].y;
	
	
	//Initialization for enemies
	for(i=0;i<2;i++){
		
		Enemy[i].x = 20 + 60*i;										//Set starting x location
		Enemy[i].y = 50;													//Set starting y location
		Enemy[i].vx = 1 + -2*i;										//Set rate of change of x (velocity)
		Enemy[i].vy = 1 + -2*i;										//Set rate of change of y
		Enemy[i].image = BasicEnemyArt;						//Sprite of entity with alive status
		Enemy[i].life = alive;										//Set the initial status of the entity
		Enemy[i].lifenum = 3;											//Gives the basic enemy three lives
		Enemy[i].deathSeq = 2;										//Specifies the amount of death animations this sprite has
		Enemy[i].w = 30;													//Specifies the width of the sprite
		Enemy[i].h = 30;													//Specifies the height of the sprite
		Enemy[i].needDraw = 1;										//Sets the flag to request sprite being drawn onto the LCD display
		Enemy[i].leftHitbox = Enemy[i].x + 2;
		Enemy[i].rightHitbox = Enemy[i].x + Enemy[i].w - 2;
		Enemy[i].frontHitbox = Enemy[i].y;
		Enemy[i].backHitbox = Enemy[i].y - Enemy[i].h;
		
	}
	
	//Initialization for enemy's bullets
	for(i=0;i<8;i++){
		
		Bullet[i].x = 0;
		Bullet[i].y = 0;
		Bullet[i].vx = 0;
		Bullet[i].vy = 0;
		Bullet[i].image = BulletArt;
		Bullet[i].life = dead;
		Bullet[i].lifenum = 0;
		Bullet[i].deathSeq = 0;
		Bullet[i].w = 3;
		Bullet[i].h = 6;
		Bullet[i].needDraw = 0;
		Bullet[i].leftHitbox = Bullet[i].x + 1;
		Bullet[i].rightHitbox = Bullet[i].x + 2;
		Bullet[i].frontHitbox = Bullet[i].y;
		Bullet[i].backHitbox = Bullet[i].y - 3;	//Is a back hitbox necessary?
		
	}
	
	//Initialization for player's bullets
	for(i=0;i<3;i++){
		
		PBullet[i].x = 0;
		PBullet[i].y = 0;
		PBullet[i].vx = 0;
		PBullet[i].vy = 0;
		PBullet[i].image = PlayerBulletArt;
		PBullet[i].life = dead;
		PBullet[i].lifenum = 0;
		PBullet[i].deathSeq = 0;
		PBullet[i].w = 3;
		PBullet[i].h = 7;
		PBullet[i].needDraw = 0;
		PBullet[i].leftHitbox = PBullet[i].x + 1;
		PBullet[i].rightHitbox = PBullet[i].x + 2;
		PBullet[i].frontHitbox = PBullet[i].y - 7;
		PBullet[i].backHitbox = PBullet[i].y;	//Is a back hitbox necessary?
		
	}
	
	//FOR DEBUGGING ONLY!
	//Indicators for the border of the display
	//ST7735_DrawFastVLine(0, 0, 159, ST7735_BLUE);
	//ST7735_DrawFastVLine(127, 0, 159, ST7735_BLUE);
	//ST7735_DrawFastHLine(0,0,127, ST7735_BLUE);
	//ST7735_DrawFastHLine(0,159,127, ST7735_BLUE);
	
	//Border in which enemy cannot cross into the player unless for suicide enemies
	//ST7735_DrawFastHLine(0,100,127, ST7735_RED);
	
	//Border which separates multiple enemies apart since I'm too dumb to make entity collision detection with each others
	//ST7735_DrawFastVLine(64,0,100, ST7735_BLUE);
	
}


/////////////////////////////////////////////////////
//Section to run the game by updating entity status//
/////////////////////////////////////////////////////

//FOR DEBUGGING ONLY!
//static int deadCount = 0;				//Counts how many times the player has been hit
//static int enemyDeadcount = 0;	//Counts how many times the enemy has been hit

unsigned int EnemyPos[2][2];			//Global variable to pass locational coordinate values of enemy entity to BulletActivation function
unsigned int PlayerPos[2];				//Global variable to pass locational coordinate values of player entity to PBulletActivation function
extern signed int playerAdd;			//TODO

void GameMovement(void){					//Updates entities and screen output at 30Hz
	
	unsigned int leftMin,rightMax,frontMax,backMin,start,stop,g,i,j = 0;	//Moved declarations inside function to save memory by not making it global
	victoryOver = 1;																											//Setting the game to be over initially, but if there is enemy, this will be changed to false
	gameOver = 1;
	
	/////////////////////
	//The enemy section//
	/////////////////////
	for(i=0; i<2; i++){
		
		//Boundary control for enemies
		if(Enemy[i].life == alive){
			
			Enemy[i].needDraw = 1;			//GameDraw(); acknowledges the needDraw flag through Enemy[i].needDraw = 0; We set it again here for alive entities so it gets updated by GameDraw(); again
			victoryOver = 0;						//As long as there is an enemy alive, the game does not end as this will keep being set as 0
			
			switch(i){
				
				case 0:
					leftMin = 3;			//leftHitbox < a
					rightMax = 63;		//rightHitbox > b
					frontMax = 97;		//frontHitbox > c
					backMin = 3;			//backHitbox < d
					break;
					
				case 1:
					leftMin = 66;			//leftHitbox < a
					rightMax = 124;		//rightHitbox > b
					frontMax = 97;		//frontHitbox > c
					backMin = 3;			//backHitbox < d
					break;
			}
			
			if(Enemy[i].lifenum == 0){
				Sound_Explosion();
				Enemy[i].life = dead;
			}
			
			//Bounce off boundaries
			if(Enemy[i].leftHitbox < leftMin || Enemy[i].rightHitbox > rightMax){
				Enemy[i].vx *= -1;																											
			}																										 
			
			if(Enemy[i].frontHitbox > frontMax || Enemy[i].backHitbox < backMin){
				Enemy[i].vy *= -1;
			}
				
			Enemy[i].x += Enemy[i].vx;
			Enemy[i].leftHitbox = Enemy[i].x + 2;
			Enemy[i].rightHitbox = Enemy[i].x + Enemy[i].w - 2;
			Enemy[i].y += Enemy[i].vy;
			Enemy[i].frontHitbox = Enemy[i].y - 2;
			Enemy[i].backHitbox = Enemy[i].y - Enemy[i].h;
			
		}
		
		else{}
		
		EnemyPos[0][i] = Enemy[i].x;	//Stores the location of the two enemy airplanes globally
		EnemyPos[1][i] = Enemy[i].y;
			
	}
	
	//////////////////////
	//The player section//
	//////////////////////
	if(Player[0].life == alive){
		
		Player[0].needDraw = 1;
		gameOver = 0;
		
		if(Player[0].lifenum == 0){		//Player is dead after lives drop from 3 to 0
			Player[0].life = dead;
		}
		
		else if(Player[0].leftHitbox < 3){
			playerAdd = 0;
			Player[0].x += 2;
		}
	
		else if(Player[0].rightHitbox > 126){
			playerAdd = 0;
			Player[0].x -= 2;
		}

		Player[0].x += playerAdd;
		Player[0].leftHitbox = Player[0].x;
		Player[0].rightHitbox = Player[0].x + Player[0].w;;
	}
			
	PlayerPos[0] = Player[0].x;	//Stores the location of the two enemy airplanes globally
	PlayerPos[1] = Player[0].y;
	
	//////////////////////
	//The bullet section//
	//////////////////////
	for(i=0; i<8; i++){
		
		if(Bullet[i].life == alive){
			
			Bullet[i].needDraw = 1;
			
				//Boundary control for enemy's bullet
				//Kills bullet if collides with player's boundaries
				if(Bullet[i].frontHitbox > Player[0].frontHitbox && Bullet[i].leftHitbox > Player[0].leftHitbox && Bullet[i].rightHitbox < Player[0].rightHitbox ){
					Bullet[i].life = dead;
					Bullet[i].lifenum -= 1;
					Player[0].lifenum -= 1;
					//deadCount++;	FOR DEBUGGING ONLY!
				}
			
				//Kills bullet if it travels out of the map
				else if(Bullet[i].frontHitbox == 160){
					Bullet[i].life = dead;
					Bullet[i].lifenum -= 1;
				}
				
				else{
					Bullet[i].y += Bullet[i].vy;
					Bullet[i].frontHitbox = Bullet[i].y;
					Bullet[i].backHitbox = Bullet[i].y - Bullet[i].h;
				}
		
		}
		
	}
	
	///////////////////////////////
	//The player's bullet section//
	///////////////////////////////
	for(i=0; i<3; i++){
		
		for(j=0; j<2; j++){	//TODO description of why j is here
		
			if(PBullet[i].life == alive){
			
				PBullet[i].needDraw = 1;
				
				switch(j){
				
				case 0:
					start = 0;
					stop = 4;
					break;
					
				case 1:
					start = 4;
					stop = 8;
					break;
			}
				
				//Kills bullet if collides with enemy's bullet
				for(g=start; g<stop; g++){
					if(PBullet[i].frontHitbox <= Bullet[g].frontHitbox && PBullet[i].leftHitbox >= (Bullet[g].leftHitbox - 1) && PBullet[i].rightHitbox <= Bullet[g].rightHitbox){
						PBullet[i].life = dead;
						PBullet[i].lifenum -= 1;
					}
					
					else{}
				}
			
				//Kills bullet if collides with enemy's boundaries
				if(PBullet[i].frontHitbox <= Enemy[j].frontHitbox && PBullet[i].leftHitbox > Enemy[j].leftHitbox && PBullet[i].rightHitbox < Enemy[j].rightHitbox){
					PBullet[i].life = dead;
					PBullet[i].lifenum -= 1;
					Enemy[j].lifenum -= 1;
					//enemyDeadcount++; 	FOR DEBUGGING ONLY!
				}
					
				//Kills bullet if it travels out of the map
				else if(PBullet[i].frontHitbox == 1){
					PBullet[i].life = dead;
					PBullet[i].lifenum -= 1;
				}
				
				else{
					PBullet[i].y += PBullet[i].vy;
					PBullet[i].frontHitbox = PBullet[i].y - PBullet[i].h;
					PBullet[i].backHitbox = PBullet[i].y;
				}
			}
		}
	}
}


///////////////////////////////////////////////////////////////////////////////
//Section to draw the graphics after GameMovement(); has updated the entities//
///////////////////////////////////////////////////////////////////////////////
void GameDraw(void){
	
	int i;
	
	//Draws player
	if(Player[0].needDraw == 1){
			
			if(Player[0].life == alive){
				ST7735_DrawBitmap(Player[0].x,Player[0].y,Player[0].image,Player[0].w,Player[0].h);
			}
			
			else{
				ST7735_DrawBitmap(Player[0].x,Player[0].y,ExplosionArt,30,30);
			}
			
			Player[0].needDraw = 0;
			
		}
	
	//Draws enemies
	for(i=0; i<2; i++){
		
		if(Enemy[i].needDraw == 1 || Enemy[i].deathSeq > 0){
			
			if(Enemy[i].life == alive){
				ST7735_DrawBitmap(Enemy[i].x,Enemy[i].y,Enemy[i].image,Enemy[i].w,Enemy[i].h);
			}
			
			else{
				
				if(Enemy[i].deathSeq == 2){
					ST7735_DrawBitmap(Enemy[i].x,Enemy[i].y,ExplosionArt,30,30);
					Enemy[i].deathSeq--;
				}
				
				else if(Enemy[i].deathSeq == 1){
					ST7735_FillRect(Enemy[i].x, Enemy[i].y - Enemy[i].h, Enemy[i].w, Enemy[i].h, 0xFFFF);
					Enemy[i].deathSeq--;
				}
			}
			
			Enemy[i].needDraw = 0;
			
		}
		
		else{}
		
	}
	
	//Draws enemy's bullets
	for(i=0; i<8; i++){
		
		if(Bullet[i].needDraw == 1){

			if(Bullet[i].life == alive){
				ST7735_DrawBitmap(Bullet[i].x,Bullet[i].y,Bullet[i].image,Bullet[i].w,Bullet[i].h);
			}
		
			else{
				ST7735_FillRect(Bullet[i].x, Bullet[i].y - Bullet[i].h, Bullet[i].w, Bullet[i].h, 0xFFFF);
			}
			
			Bullet[i].needDraw = 0;
			
		}
		
		else{}
		
	}
	
	//Draws player's bullets
	for(i=0; i<3; i++){
		
		if(PBullet[i].needDraw == 1){

			if(PBullet[i].life == alive){
				ST7735_DrawBitmap(PBullet[i].x,PBullet[i].y,PBullet[i].image,PBullet[i].w,PBullet[i].h);
			}
		
			else{
				ST7735_FillRect(PBullet[i].x, PBullet[i].y - PBullet[i].h, PBullet[i].w, PBullet[i].h, 0xFFFF);
			}
			
			PBullet[i].needDraw = 0;
			
		}
		
		else{}
		
	}
	
}

//FOR DEBUGGING ONLY!
//unsigned long IRQCounter = 0;		//Increments every iteration of GameTask
//unsigned long mainCounter = 0;	//Increments every iteration of the main loop

//Function to be called at 30Hz by timer
void GameTask(void){
	GameMovement();
	Flag = 1;
	//IRQCounter++;
}


/////////////////////////////////////////////////////////////////////////////////////////////////////////////////////////////////////////////////
//This function initializes the start of the bullet life cycle at the nose of enemy's airplane, also makes status alive and request to be drawn//
/////////////////////////////////////////////////////////////////////////////////////////////////////////////////////////////////////////////////
void BulletActivate(void){
	
	int n, alreadyActivated = 0;
	int m = 0;	//Indicates which enemy, Enemy[0] or Enemy[1]

		//Bullet activate for Enemy[0]
		for(n=0; n<4; n++){
	
			if(Bullet[n].life == dead && alreadyActivated == 0 && Enemy[m].life == alive){
				Bullet[n].x = EnemyPos[0][m] + (Enemy[m].w / 2);
				Bullet[n].y = EnemyPos[1][m];
				Bullet[n].frontHitbox = Bullet[n].y;
				Bullet[n].leftHitbox = Bullet[n].x + 1;
				Bullet[n].rightHitbox = Bullet[n].x + 2;
				Bullet[n].vy = 1;
				Bullet[n].life = alive;
				Bullet[n].lifenum = 1;
				Bullet[n].needDraw = 1;
			
				alreadyActivated = 1;
			}
		}
		
		m++;
		alreadyActivated = 0;
		
		//Bullet activate for Enemy[1]
		for(n=4; n<8; n++){
			
			if(Bullet[n].life == dead && alreadyActivated == 0 && Enemy[m].life == alive){
				Bullet[n].x = EnemyPos[0][m] + (Enemy[m].w / 2);	
				Bullet[n].y = EnemyPos[1][m];
				Bullet[n].frontHitbox = Bullet[n].y;
				Bullet[n].leftHitbox = Bullet[n].x + 1;
				Bullet[n].rightHitbox = Bullet[n].x + 2;
				Bullet[n].vy = 1;
				Bullet[n].life = alive;
				Bullet[n].lifenum = 1;
				Bullet[n].needDraw = 1;
			
				alreadyActivated = 1;
			}
		}
}


//////////////////////////////////////////////////////////////////////////////////////////////////////////////////////////////////////////////////
//This function initializes the start of the bullet life cycle at the nose of player's airplane, also makes status alive and request to be drawn//
//////////////////////////////////////////////////////////////////////////////////////////////////////////////////////////////////////////////////
void PBulletActivate(void){
	
	int n, alreadyActivated = 0;

		for(n=0; n<3; n++){
	
			if(PBullet[n].life == dead && alreadyActivated == 0){
				PBullet[n].x = PlayerPos[0]	+ (Player[0].w / 2);
				PBullet[n].y = PlayerPos[1] - Player[0].h;
				PBullet[n].frontHitbox = PBullet[n].y + PBullet[n].h;
				PBullet[n].leftHitbox = PBullet[n].x + 1;
				PBullet[n].rightHitbox = PBullet[n].x + 2;
				PBullet[n].vy = -1;
				PBullet[n].life = alive;
				PBullet[n].lifenum = 1;
				PBullet[n].needDraw = 1;
				
				Sound_Shoot();
			
				alreadyActivated = 1;
			}
		}
}

//Function Declarations
void DisableInterrupts(void);
void EnableInterrupts(void);
void WaitForInterrupt(void);

int main(void){
	
	DisableInterrupts();
  PLL_Init();
	Output_Init();
	GameInit();
	PortB_Init();
	PortD_Init();
	SysTick_Init(&PBulletActivate,30);
	Timer2_Init(&GameTask,(80000000/30));
	Timer1_Init(&BulletActivate,(80000000/1));
	ADC_Init();
	Sound_Init();
	EnableInterrupts();
	
	do{
		
		while(Flag == 0){};		//This logic makes sure that GameMovement has updated the status of the game first before GameDraw occurs
			Flag = 0;						//This prevents bitmap being drawn when GameMovement is still updating the situation of the game
			GameDraw();
			
			//Drives the LEDs to indicate player's health
			if(Player[0].lifenum == 3){
				GPIO_PORTD_DATA_R |= 0x07;
			}
			
			else if(Player[0].lifenum == 2){
				GPIO_PORTD_DATA_R &= ~0x04;
			}
			
			else if(Player[0].lifenum == 1){
				GPIO_PORTD_DATA_R &= ~0x02;
			}
			
			else{
				GPIO_PORTD_DATA_R &= ~0x01;
			}
			
			//mainCounter++;
	
	}while(!gameOver && !victoryOver);
	
	//Victory screen
	if(victoryOver){
		ST7735_FillScreen(0xFFFF);
		ST7735_DrawBitmap(37,80,VictoryArt,50,50);
		Output_Color(0);
		ST7735_SetCursor(6,10);
		printf("You won!");
	}
	
	//Lose screen
	else{
		ST7735_FillScreen(0xFFFF);
		ST7735_DrawBitmap(37,80,DeathArt,50,50);
		Output_Color(0);
		ST7735_SetCursor(6,10);
		printf("Game Over!");
	}

}
